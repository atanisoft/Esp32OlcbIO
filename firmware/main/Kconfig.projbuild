## firmware/main/Kconfig.projbuild
```kconfig
menu "IO Pin Configuration"
    config IOPIN_PULL_UP_ENABLED
        bool "Enable built-in pull-up"
        default n
        help
            Enabling this option will enable the built-in pull-up resistor for
            all IO pins by default.
            NOTE: IO6, IO 9, IO 10, Factory Reset button and User Button will
            always have pull-up enabled.
            NOTE: IO7 will always have pull-down enabled.
endmenu

menu "OpenLCB Configuration"
    config OLCB_NODE_AUTO_ASSIGN
        bool "Automatically assign Node ID"
        default y
        help
            When this option is enabled the OpenLCB Node ID will automatically
            be assigned based on the MAC address of the ESP32. The node ID will
            be: 02.02.05.{mac 3}.{mac 4}.{mac 5}
            where {mac 3}, {mac 4} and {mac 5} are the guaranteed unique
            portion of the ESP32 MAC address.

    config OLCB_NODE_ID
        hex "Node ID"
        default 0x050201030000
        depends on !OLCB_NODE_AUTO_ASSIGN
        help 
            This is the OpenLCB unique node identifier for the ESP32 OpenLCB IO
            Board. It is recommended, but not required, to request your own
            identifier range via:
            https://registry.openlcb.org/requestuniqueidrange
            The default node identifier is part of a reserved range of
            identifier values.

    config OLCB_ENABLE_TWAI
        bool "Enable TWAI (CAN) interface"
        default y

    config OLCB_ENABLE_PWM
        bool "Enable PCA9685 PWM interface"
        default n

    menu "Advanced"
        choice OLCB_WIFI_MODE
            bool "WiFi Uplink/Hub Behavior"
            default OLCB_WIFI_MODE_OFF if OLCB_TWAI
            default OLCB_WIFI_MODE_UPLINK_ONLY
            config OLCB_WIFI_MODE_UPLINK_ONLY
                bool "Uplink Only"
            config OLCB_WIFI_MODE_HUB_ONLY
                bool "Hub Only"
            config OLCB_WIFI_MODE_HUB_AND_UPLINK
                bool "Hub and Uplink"
            config OLCB_WIFI_MODE_OFF
                bool "Disabled"
        endchoice

        config OLCB_WIFI_MODE
            int
            default 0 if OLCB_WIFI_MODE_OFF
            default 1 if OLCB_WIFI_MODE_HUB_ONLY
            default 2 if OLCB_WIFI_MODE_UPLINK_ONLY
            default 3 if OLCB_WIFI_MODE_HUB_AND_UPLINK

        config OLCB_EXECUTOR_SELECT_PRESCALER
            int "StateFlows to execute between select() calls"
            range 5 300
            default 60
            help
                Executors will run this many Executables (if there is anything
                scheduled) before two calls to select. This helps in reducing the
                overhead of the select calls.

        config OLCB_GC_OUTBOUND_PACKET_LIMIT
            int "GridConnect outbound packet count limit"
            default 5
            help
                Number of pending buffers (of type string) in the outgoing hub on a
                per-connection basis. This limit ensures that we don't leak memory
                if the output socket cannot send the data fast enough.

        config OLCB_PRINT_ALL_PACKETS
            bool "Print all packets"
            default n
            help
                Enabling this option will cause all LCC packets to be printed to
                the serial console.

        config OLCB_GC_NEWLINES
            bool "Add newline to GridConnect packets"
            default y if OLCB_PRINT_ALL_PACKETS
            default n
            help
                Enabling this option will generate a newline character after
                every GridConnect packet that is sent out. This is generally
                only needed for debug purposes.

        config OLCB_GC_BUFFER_SIZE
            int "GridConnect Buffer fill time (usec)"
            default LWIP_TCP_MSS
            help
                Size of the GridConnect buffer in bytes.

        config OLCB_GC_BUFFER_DELAY_USEC
            int "GridConnect Buffer fill time (usec)"
            default 2000
            help
                Number of microseconds to allow the GridConnect buffer to fill
                before flushing to the socket.

        config OLCB_TWAI_RX_BUFFER_SIZE
            int "Number of TWAI (CAN) packets to queue for RX"
            range 16 128
            default 32

        config OLCB_TWAI_TX_BUFFER_SIZE
            int "Number of TWAI (CAN) packets to queue for TX"
            range 16 128
            default 32
    endmenu
endmenu

menu "WiFi Configuration"
    choice WIFI_MODE
        bool "WiFi Mode"
        config WIFI_MODE_SOFTAP
            bool "SoftAP only"
        config WIFI_MODE_STATION
            bool "Station only"
        config WIFI_MODE_SOFTAP_STATION
            bool "SoftAP and Station"
        config WIFI_MODE_OFF
            bool "Off"
    endchoice

    config WIFI_MODE
        int
        default 0 if WIFI_MODE_OFF
        default 1 if WIFI_MODE_STATION
        default 2 if WIFI_MODE_SOFTAP
        default 3 if WIFI_MODE_SOFTAP_STATION

    config WIFI_HOSTNAME_PREFIX
        string "Hostname prefix"
        default "esp32io_"
        help
            The OpenLCB node identifier will be appended to this value, ie:
            esp32io_0502010300000.
            Note: The maximum hostname length is 32 characters.

    config WIFI_SOFTAP_SSID
        string "SoftAP SSID"
        default "esp32olcbio"
        depends on WIFI_MODE_SOFTAP || WIFI_MODE_SOFTAP_STATION

    config WIFI_SOFTAP_PASSWORD
        string "SoftAP Password"
        default "esp32olcbio"
        depends on WIFI_MODE_SOFTAP || WIFI_MODE_SOFTAP_STATION
        help
            Note: When the authentication mode uses WPA (any version) the
            password must be at least eight characters in length.

    config WIFI_SOFTAP_CHANNEL
        int "SoftAP Channel"
        default 1
        range 1 14
        depends on WIFI_MODE_SOFTAP || WIFI_MODE_SOFTAP_STATION
        help
            This configures the channel that will be used by the SoftAP. There
            are fourteen channels available to pick from and some are better
            than others. The best channels to pick from are: 1, 6, 11 since
            these do not overlap with other channels.

    config WIFI_STATION_SSID
        string "Station SSID"
        depends on WIFI_MODE_STATION || WIFI_MODE_SOFTAP_STATION

    config WIFI_STATION_PASSWORD
        string "Station Password"
        depends on WIFI_MODE_STATION || WIFI_MODE_SOFTAP_STATION

    config SNTP
        bool "Enable SNTP synchronization"
        default n
        depends on WIFI_MODE_STATION || WIFI_MODE_SOFTAP_STATION
        help
            By enabling this option the ESP32 will attempt to synchronize the
            system time with an external SNTP server once per hour.

    config SNTP_SERVER
        string "SNTP Server"
        default "pool.ntp.org"
        depends on SNTP

    config TIMEZONE
        string "Timezone"
        default "UTC0"
        depends on SNTP
        help
            This is the timezone that the ESP32 OpenLCB IO Board is running in.
            The value must follow POSIX notation.
            A few common values:
            * PST8PDT,M3.2.0,M11.1.0 -- UTC-8 with automatic DST adjustment
            * MST7MDT,M3.2.0,M11.1.0 -- UTC-7 with automatic DST adjustment
            * CST6CDT,M3.2.0,M11.1.0 -- UTC-6 with automatic DST adjustment
            * EST5EDT,M3.2.0,M11.1.0 -- UTC-5 with automatic DST adjustment
            A complete list can be seen here in the second column:
            https://github.com/nayarsystems/posix_tz_db/blob/master/zones.csv
endmenu

menu "Advanced Configuration"
    config ENABLE_TASK_LIST_REPORTING
        bool "Enable TaskList reporting"
        default n
        select FREERTOS_VTASKLIST_INCLUDE_COREID
        select FREERTOS_USE_TRACE_FACILITY
        select FREERTOS_GENERATE_RUN_TIME_STATS

    config TASK_LIST_INTERVAL
        int "Task list interval (sec)"
        default 25
        depends on ENABLE_TASK_LIST_REPORTING

    config HEALTH_INTERVAL
        int "Health report interval (sec)"
        default 15
endmenu
```

## firmware/sdkconfig.defaults
```kconfig
#
# Bootloader config
#
CONFIG_BOOTLOADER_LOG_LEVEL_NONE=y

#
# Serial flasher config
#
CONFIG_ESPTOOLPY_FLASHSIZE_4MB=y

#
# Heap memory debugging
#
CONFIG_HEAP_POISONING_LIGHT=y

#
# Partition Table
#
CONFIG_PARTITION_TABLE_CUSTOM=y
CONFIG_PARTITION_TABLE_CUSTOM_FILENAME="esp32io-partitions.csv"

#
# Log output
#
CONFIG_LOG_DEFAULT_LEVEL_ERROR=y
CONFIG_LOG_COLORS=n
CONFIG_LOG_TIMESTAMP_SOURCE_RTOS=y

#
# Compiler options
#
CONFIG_COMPILER_OPTIMIZATION_PERF=y
CONFIG_COMPILER_OPTIMIZATION_ASSERTIONS_ENABLE=y
CONFIG_COMPILER_CXX_EXCEPTIONS=y
CONFIG_COMPILER_STACK_CHECK_MODE_NORM=y
CONFIG_COMPILER_STACK_CHECK=y
CONFIG_COMPILER_WARN_WRITE_STRINGS=y

# NOTE: ESP-IDF defaults to 160Mhz mode!
CONFIG_ESP_DEFAULT_CPU_FREQ_240=y
CONFIG_ESP_XTAL_FREQ_AUTO=y

#
# Common ESP-related
#
CONFIG_ESP_MAIN_TASK_STACK_SIZE=4096
CONFIG_ESP_CONSOLE_UART=y
CONFIG_ESP_SYSTEM_EVENT_TASK_STACK_SIZE=2048

#
# FreeRTOS configuration
#
CONFIG_FREERTOS_HZ=1000
CONFIG_FREERTOS_IDLE_TASK_STACKSIZE=1024
CONFIG_FREERTOS_WATCHPOINT_END_OF_STACK=y

#
# libsodium
#
CONFIG_LIBSODIUM_USE_MBEDTLS_SHA=y

#
# LwIP configuration
#
CONFIG_LWIP_SO_RCVBUF=y
CONFIG_LWIP_LOCAL_HOSTNAME="esp32io"
# disable IRAM optimization due to https://github.com/espressif/esp-idf/issues/5734
CONFIG_LWIP_IRAM_OPTIMIZATION=n
CONFIG_LWIP_MAX_SOCKETS=16
CONFIG_LWIP_ETHARP_TRUST_IP_MAC=y
CONFIG_LWIP_DHCP_RESTORE_LAST_IP=y
CONFIG_LWIP_MAX_LISTENING_TCP=5
# Increase MSS to maximum value (1460)
CONFIG_LWIP_TCP_MSS=1460
# SNDBUF size is 6x MSS
CONFIG_LWIP_TCP_SND_BUF_DEFAULT=8760
# WND size is 10x MSS
CONFIG_LWIP_TCP_WND_DEFAULT=14600
# RECVMBOX is (WND / MSS) + 2
CONFIG_LWIP_TCP_RECVMBOX_SIZE=22
CONFIG_LWIP_TCPIP_RECVMBOX_SIZE=64
CONFIG_LWIP_TCPIP_TASK_STACK_SIZE=2560
CONFIG_LWIP_DHCP_DOES_ARP_CHECK=n

#
# UDP
#
CONFIG_LWIP_MAX_UDP_PCBS=8

#
# Wi-Fi configuration
#
CONFIG_ESP_WIFI_NVS_ENABLED=n
CONFIG_ESP_WIFI_STATIC_RX_BUFFER_NUM=16
CONFIG_ESP_WIFI_RX_BA_WIN=16
CONFIG_ESP_WIFI_RX_IRAM_OPT=n
CONFIG_ESP_WIFI_IRAM_OPT=n

#
# Watchdog configuration
#
CONFIG_ESP_TASK_WDT=n

#
# mbedTLS configuration
#
CONFIG_MBEDTLS_DEFAULT_MEM_ALLOC=y
CONFIG_MBEDTLS_HARDWARE_MPI=y
CONFIG_MBEDTLS_TLS_CLIENT_ONLY=y
CONFIG_MBEDTLS_TLS_CLIENT=y
CONFIG_MBEDTLS_TLS_ENABLED=y
CONFIG_MBEDTLS_ECP_C=y
CONFIG_MBEDTLS_ECDH_C=y
CONFIG_MBEDTLS_ECDSA_C=y
CONFIG_MBEDTLS_ECP_DP_SECP192R1_ENABLED=y
CONFIG_MBEDTLS_ECP_DP_SECP224R1_ENABLED=y
CONFIG_MBEDTLS_ECP_DP_SECP256R1_ENABLED=y
CONFIG_MBEDTLS_ECP_DP_SECP384R1_ENABLED=y
CONFIG_MBEDTLS_ECP_DP_SECP521R1_ENABLED=y
CONFIG_MBEDTLS_ECP_DP_SECP192K1_ENABLED=y
CONFIG_MBEDTLS_ECP_DP_SECP224K1_ENABLED=y
CONFIG_MBEDTLS_ECP_DP_SECP256K1_ENABLED=y
CONFIG_MBEDTLS_ECP_DP_BP256R1_ENABLED=y
CONFIG_MBEDTLS_ECP_DP_BP384R1_ENABLED=y
CONFIG_MBEDTLS_ECP_DP_BP512R1_ENABLED=y
CONFIG_MBEDTLS_ECP_DP_CURVE25519_ENABLED=y
CONFIG_MBEDTLS_ECP_NIST_OPTIM=y
CONFIG_MBEDTLS_PSK_MODES=y

#
# WPA configuration
#
# NOTE: the option below requires CONFIG_MBEDTLS_HARDWARE_MPI to be enabled,
# see https://github.com/espressif/esp-idf/issues/5321 for details.
CONFIG_WPA_MBEDTLS_CRYPTO=y

#
# LittleFS
#
CONFIG_LITTLEFS_MAX_PARTITIONS=1
```
